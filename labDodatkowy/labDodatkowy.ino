#include <Wire.h>

#include <Adafruit_SH110X.h>

#define i2c_Address 0x3c //initialize with the I2C addr 0x3C Typically eBay OLED's

#define SCREEN_WIDTH 128 // OLED display width, in pixels
#define SCREEN_HEIGHT 64 // OLED display height, in pixels
#define OLED_RESET -1   //   QT-PY / XIAO
Adafruit_SH1106G display = Adafruit_SH1106G(SCREEN_WIDTH, SCREEN_HEIGHT, &Wire, OLED_RESET);


#define NUMFLAKES 5
#define XPOS 0
#define YPOS 1
#define DELTAY 2

#define LOGO16_GLCD_HEIGHT 32
#define LOGO16_GLCD_WIDTH  32
static const unsigned char PROGMEM logo16_glcd_bmp[] =
{ 0x00, 0x00, 0x00, 0x00, 0x00, 0x00, 0x00, 0x00, 0x00, 0x00, 0x00, 0x00, 0x00, 0x01, 0x80, 0x00, 
  0x00, 0x07, 0x80, 0x00, 0x00, 0x0f, 0x80, 0x00, 0x00, 0x0f, 0x80, 0x00, 0x00, 0x1e, 0x38, 0x00, 
  0x00, 0x39, 0x88, 0x00, 0x00, 0x32, 0x78, 0x00, 0x00, 0x25, 0xf0, 0x00, 0x00, 0x4b, 0xe0, 0x00, 
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  0x00, 0x01, 0x8c, 0x00, 0x00, 0x07, 0xbf, 0x80, 0x00, 0x00, 0x00, 0x00, 0x00, 0x00, 0x00, 0x00
};

#define LOGO_HEIGHT 64
#define LOGO_WIDTH  64

static const unsigned char PROGMEM logo16_glcd_bmp2[] =
{ 
  0xff, 0xff, 0xff, 0xff, 0xff, 0xff, 0xff, 0xff, 0xff, 0xff, 0xff, 0xff, 0xff, 0xff, 0xff, 0xff, 
  0xff, 0xff, 0xff, 0xff, 0xff, 0xf7, 0xff, 0xfe, 0xed, 0xbf, 0xff, 0xfe, 0x1f, 0xdf, 0x7f, 0xff, 
  0xff, 0xff, 0xff, 0xf7, 0xe7, 0xff, 0xff, 0xfd, 0xff, 0xff, 0xff, 0xc7, 0x4b, 0xff, 0xff, 0xff, 
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  0xa2, 0x48, 0x02, 0x22, 0x86, 0x42, 0x2a, 0x24, 0x92, 0x4a, 0xc9, 0x88, 0xa1, 0x09, 0x09, 0x24
};

void setup()   {
  Serial.begin(9600);


  if(!display.begin(i2c_Address, true)) {
    Serial.println(F("Nie znaleziono wyswietlacza SH1106"));
    for(;;);
  }

  display.clearDisplay();

  display.drawBitmap(32, 0, logo16_glcd_bmp2, LOGO_WIDTH, LOGO_HEIGHT, SH110X_WHITE);
  
  display.display();

  // by default, we'll generate the high voltage from the 3.3v line internally! (neat!)
  display.begin(i2c_Address, true); // Address 0x3C default
  // init done
   delay(5000);

  // Clear the buffer.
  display.clearDisplay();


  // text display tests
  display.setTextSize(2);
  display.setTextColor(SH110X_WHITE);
  display.setCursor(15, 5);
  display.println("WESOLYCH");
  display.setTextColor(SH110X_BLACK, SH110X_WHITE); // 'inverted' text
  display.setTextColor(SH110X_WHITE);
  display.setCursor(30, 25);
  display.println("SWIAT");
  display.setTextColor(SH110X_BLACK, SH110X_WHITE); 
  display.setCursor(15, 45);
  display.setTextColor(SH110X_WHITE);
  display.println("GIGANOCY");
  display.setTextColor(SH110X_BLACK, SH110X_WHITE); 
  display.display();
  delay(5000);
  display.clearDisplay();
  testdrawbitmap(logo16_glcd_bmp, LOGO16_GLCD_HEIGHT, LOGO16_GLCD_WIDTH);

}


void loop() {

}

void testdrawbitmap(const uint8_t *bitmap, uint8_t w, uint8_t h) {
  uint8_t icons[NUMFLAKES][3];

  // initialize
  for (uint8_t f = 0; f < NUMFLAKES; f++) {
    icons[f][XPOS] = random(display.width());
    icons[f][YPOS] = 0;
    icons[f][DELTAY] = random(5) + 1;

    Serial.print("x: ");
    Serial.print(icons[f][XPOS], DEC);
    Serial.print(" y: ");
    Serial.print(icons[f][YPOS], DEC);
    Serial.print(" dy: ");
    Serial.println(icons[f][DELTAY], DEC);
  }

  while (1) {
    // draw each icon
    for (uint8_t f = 0; f < NUMFLAKES; f++) {
      display.drawBitmap(icons[f][XPOS], icons[f][YPOS], bitmap, w, h, SH110X_WHITE);
    }
    display.display();
    delay(200);

    // then erase it + move it
    for (uint8_t f = 0; f < NUMFLAKES; f++) {
      display.drawBitmap(icons[f][XPOS], icons[f][YPOS], bitmap, w, h, SH110X_BLACK);
      // move it
      icons[f][YPOS] += icons[f][DELTAY];
      // if its gone, reinit
      if (icons[f][YPOS] > display.height()) {
        icons[f][XPOS] = random(display.width());
        icons[f][YPOS] = 0;
        icons[f][DELTAY] = random(5) + 1;
      }
    }
  }
}
